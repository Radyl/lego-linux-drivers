## pistorms/Kconfig
```kconfig
menuconfig PISTORMS
    tristate "mindsensors.com PiStorms support"
	select NEW_LEDS
	select LEDS_CLASS
	help
	  Say Y here if you want to use mindsensors.com PiStorms.

	  To compile this driver as a module, choose M here: the
	  module will be called pistorms.
```
